#include <SPI.h>
#include <Wire.h>
#include <Adafruit_GFX.h>
#include <Adafruit_SSD1306.h>

#define SCREEN_WIDTH 128 // OLED display width, in pixels
#define SCREEN_HEIGHT 64 // OLED display height, in pixels

#define OLED_RESET 4        // Reset pin # (or -1 if sharing Arduino reset pin)
#define SCREEN_ADDRESS 0x3C ///< See datasheet for Address; 0x3D for 128x64, 0x3C for 128x64

Adafruit_SSD1306 display(SCREEN_WIDTH, SCREEN_HEIGHT, &Wire, OLED_RESET);

// 以上部分是12864的初始化

// #include "BluetoothSerial.h"
// BluetoothSerial SerialBT;

unsigned char PROGMEM logo_bmp[] =
    {

        0b00000000,
        0b00000000,
        0b00000000,
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        0b00000111,

};

// 这是一个一开始会显示的logo

// 定义程序中需要的变量
unsigned char PROGMEM serialphoto[1024] = {}; //每个位置储存一个buffer
char buffer[9];                               //Buffer用于承载8个字符串
int num = 0;                                  //num用于计算目前记录了多少个buffer
// bool CursorMoveOn = false;                    //用于判断buffer是否记录完毕
// bool StartShow = false;                       //用于判断是否要更新画面
char NewDigit;                                //serial.read()

void testdrawbitmap(void)
{
    display.clearDisplay();

    display.drawBitmap(
        0,
        0,
        logo_bmp, 128, 64, 1);

    // display.drawBitmap(
    //     (display.width()  - LOGO_WIDTH ) / 2,
    //     (display.height() - LOGO_HEIGHT) / 2,
    //     logo_bmp, LOGO_WIDTH, LOGO_HEIGHT, 1);
    display.display();
    delay(1000);
}

// 该函数用于最初生成Logo

void setup()
{

    
    // SerialBT.begin("ESP32_JYD");
    // Serial.println("BT started.Pairing");
    // Serial.setDebugOutput(true);
    // Serial.println();
    
    // 至此，打开了名为ESP32的SerialBT


    Serial.begin(460800);

    if (!display.begin(SSD1306_SWITCHCAPVCC, SCREEN_ADDRESS))
    {
        Serial.println(F("SSD1306 allocation failed"));
        for (;;)
            ; // Don't proceed, loop forever
    }

    pinMode(4, OUTPUT);
    digitalWrite(4, LOW);

    testdrawbitmap();
    delay(2000);

    // 至此，展示logo,屏幕初始化完成


    // display.clearDisplay();

    // display.setTextSize(1.5);             // Normal 1:1 pixel scale
    // display.setTextColor(SSD1306_WHITE);        // Draw white text
    // display.setCursor(0,0);             // Start at top-left corner
    // display.println(F("Hello, world!"));
    // display.setTextSize(1);
    // display.println(F("BT send 0 to test connect"));
    // display.println(F("BT send 1 to start bad apple"));
    // display.display();


}

void loop()
{
    // if (SerialBT.available())
    // {
    //     int order = SerialBT.read();
    //     display.print(F("Receive:"));
    //     display.println(F(order));
    //     if (order == 48)
    //     {
    //         display.println(F("BT connected"));
    //     }
    //     if (order == 49)
    //     {
    //         digitalWrite(4,HIGH);
    //         delay(50);
    //         digitalWrite(4,LOW);
    //         Serial.print("on");
    //     }
    // }


    if (!Serial.available())
        return;

    NewDigit = (char)Serial.read();
    // Serial.println(NewDigit);
    // if (CursorMoveOn == true)
    // {
        if ((NewDigit == '0') or (NewDigit == '1'))
        {
            for (int i = 0; i < 9; i++)
                buffer[i] = buffer[i + 1];
            buffer[8] = NewDigit - '0'; //digits中都是‘’的字符形式
            return;
        }
    // }

    // if (NewDigit == 'b')
    // {
    //     CursorMoveOn = true;
    // }

    if (NewDigit == ',')
    {
        // CursorMoveOn = false;
        serialphoto[num] = buffer[8] + 2 * (buffer[7]) + 4 * (buffer[6]) + 8 * (buffer[5]) + 16 * (buffer[4]) + 32 * (buffer[3]) + 64 * buffer[2] + 128 * buffer[1];
        num = num + 1;
        return;
    }

    if (NewDigit == '#')
    {
        num = 0;
        display.clearDisplay();

        display.drawBitmap(
            0,
            0,
            serialphoto, 128, 64, 1);

        // display.drawBitmap(
        //     (display.width()  - LOGO_WIDTH ) / 2,
        //     (display.height() - LOGO_HEIGHT) / 2,
        //     logo_bmp, LOGO_WIDTH, LOGO_HEIGHT, 1);
        display.display();
        // StartShow = false;

        
    }

    if (NewDigit == '@')
    {
        Serial.println("here");
        Serial.println(num);
        Serial.print(buffer[0]+'0');
        Serial.print(buffer[1]+'0');
        Serial.print(buffer[2]+'0');
        Serial.print(buffer[3]+'0');
        Serial.print(buffer[4]+'0');
        Serial.print(buffer[5]+'0');
        Serial.print(buffer[6]+'0');
        Serial.print(buffer[7]+'0');
        Serial.print(buffer[8]+'0');
        return;
    }


}

void serialEvent()
{
    // if (!Serial.available())
    //     return;
    // NewDigit = (char)Serial.read();
    // Serial.println(NewDigit);
    // if ((NewDigit == '0' or '1') and (CursorMoveOn =true))
    //     for (int i = 0; i < 8; i++)
    //         buffer[i] = buffer[i + 1];
    //     buffer[8] = NewDigit-'0'; //digits中都是‘’的字符形式
    // if (NewDigit == '#')
    //     StartShow = true;
    // if (NewDigit == 'b')
    //     CursorMoveOn = true;
    // if (NewDigit == ',')
    //     {
    //     CursorMoveOn = false;
    //     serialphoto[num] = buffer[7]+2*(buffer[6])+4*(buffer[5])+8*(buffer[4])+16*(buffer[3])+32*(buffer[2])+64*buffer[1]+128*buffer[0];
    //     num = num + 1;
    //     }
    // if (NewDigit == '@')
    //     {
    //         Serial.println('here');
    //         Serial.println(num);
    //         Serial.println(buffer);
    //     }
}
